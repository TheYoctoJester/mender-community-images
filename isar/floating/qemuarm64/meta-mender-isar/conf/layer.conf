## isar/floating/qemuarm64/meta-mender-isar/conf/layer.conf
```bitbake
# meta-mender-isar: Mender A/B (efibootmgr) integration for ISAR-built Debian.
BBPATH .= ":${LAYERDIR}"
BBFILES += "${LAYERDIR}/recipes-*/*/*.bb ${LAYERDIR}/recipes-*/*/*.bbappend"

BBFILE_COLLECTIONS += "mender-isar"
BBFILE_PATTERN_mender-isar = "^${LAYERDIR_RE}/"
BBFILE_PRIORITY_mender-isar = "6"

LAYERVERSION_mender-isar = "1"
LAYERSERIES_COMPAT_mender-isar = "v0.6"

LAYERDIR_mender-isar = "${LAYERDIR}"
LAYERDIR_mender-isar[vardepvalue] = "meta-mender-isar"
```

## isar/floating/qemuarm64/meta-mender-isar/conf/machine/qemuarm64-mender.conf
```bitbake
# qemuarm64 machine for the ISAR Debian A/B Mender demo.
#
# Builds on the stock ISAR qemuarm64 (arm64, virtio-blk on /dev/vda, ttyAMA0).
# Produces the rootfs .ext4 (the OTA payload, wrapped as a module-image artifact
# of type efibootmgr-rootfs) and a bootable A/B .wic disk. A/B slot selection is
# owned by the efibootmgr Mender update module (UEFI boot variables), so there is
# no bootloader on the disk -- the firmware launches an EFI-stub kernel directly.
require conf/machine/qemuarm64.conf

# Fixed PARTUUIDs so the first-boot UKI fallback + per-slot UEFI entries can name
# the rootfs slots deterministically (the efibootmgr integration relies on these).
MENDER_ISAR_ROOTA_UUID ?= "11111111-1111-1111-1111-111111111101"
MENDER_ISAR_ROOTB_UUID ?= "11111111-1111-1111-1111-111111111102"
WICVARS:append = " MENDER_ISAR_ROOTA_UUID MENDER_ISAR_ROOTB_UUID"

IMAGE_FSTYPES = "ext4 wic"
WKS_FILE = "qemuarm64-mender-ab.wks"

# wic imager needs FAT/ext tooling to build the ESP + partitions.
IMAGER_INSTALL:wic += "dosfstools mtools parted e2fsprogs"
```

## isar/floating/qemuarm64/meta-mender-isar/wic/qemuarm64-mender-ab.wks
```
# A/B GPT disk for the ISAR efibootmgr Mender demo (qemuarm64).
#
#   1. ESP   (FAT)  -> /boot/efi : EFI/BOOT/bootaa64.efi (UKI, first-boot fallback
#                                  -> rootA), EFI/mender-a/{linux.efi,initrd.img},
#                                  EFI/mender-b/{linux.efi,initrd.img}
#   2. rootA (ext4) -> /         : active rootfs, fixed PARTUUID
#   3. rootB (ext4)              : inactive Mender slot (client writes it)
#   4. data  (ext4) -> /data     : persistent Mender state (survives A/B)
#
# GPT part-names (--part-name) drive /dev/disk/by-partlabel/{ESP,rootA,rootB},
# which the efibootmgr update module + first-boot service rely on. The ESP is
# populated from the staged boot/esp tree (built in ROOTFS_POSTPROCESS_COMMAND).
# There is no on-disk bootloader: UEFI launches the EFI-stub kernel directly.

part /boot/efi --source rootfs --rootfs-dir=${MENDER_ESP_DIR} --fstype=vfat --label ESP --part-name ESP --part-type C12A7328-F81F-11D2-BA4B-00A0C93EC93B --align 1024 --size 350M --active
part / --source rootfs --fstype=ext4 --label rootA --part-name rootA --align 1024 --fixed-size 1024M --uuid ${MENDER_ISAR_ROOTA_UUID}
# rootB stays unformatted (--source empty): the efibootmgr update module dd's the
# ext4 OTA payload onto it. The data partition must be a formatted, labelled ext4
# so LABEL=data mounts at boot (a sourceless part with --fstype creates an empty fs).
part --source empty --fstype=ext4 --label rootB --part-name rootB --align 1024 --fixed-size 1024M --uuid ${MENDER_ISAR_ROOTB_UUID}
part /data --fstype=ext4 --label data --part-name data --align 1024 --size 128M

bootloader --ptable gpt
```

## yocto/scarthgap/demos/meta-mender-raspberrypi-wifi/conf/layer.conf
```bitbake
# We have a conf and classes directory, add to BBPATH
BBPATH .= ":${LAYERDIR}"

# We have recipes-* directories, add to BBFILES
BBFILES += "${LAYERDIR}/recipes-*/*/*.bb \
            ${LAYERDIR}/recipes-*/*/*.bbappend"

BBFILE_COLLECTIONS += "meta-mender-raspberrypi-wifi"
BBFILE_PATTERN_meta-mender-raspberrypi-wifi = "^${LAYERDIR}/"
BBFILE_PRIORITY_meta-mender-raspberrypi-wifi = "6"

LAYERDEPENDS_meta-mender-raspberrypi-wifi = "core"
LAYERSERIES_COMPAT_meta-mender-raspberrypi-wifi = "scarthgap"
```

## yocto/wrynose/demos/meta-mender-wifi/conf/layer.conf
```bitbake
# We have a conf and classes directory, add to BBPATH
BBPATH .= ":${LAYERDIR}"

# We have recipes-* directories, add to BBFILES
BBFILES += "${LAYERDIR}/recipes-*/*/*.bb \
            ${LAYERDIR}/recipes-*/*/*.bbappend"

BBFILE_COLLECTIONS += "meta-mender-wifi"
BBFILE_PATTERN_meta-mender-wifi = "^${LAYERDIR}/"
BBFILE_PRIORITY_meta-mender-wifi = "6"

LAYERDEPENDS_meta-mender-wifi = "core"
LAYERSERIES_COMPAT_meta-mender-wifi = "wrynose"
```
